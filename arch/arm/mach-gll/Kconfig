## arch/arm/mach-gll/Kconfig
```kconfig
if ARCH_GLL

config SYS_SOC
	default "gllcff"

config STM_GLLCFF
	bool
	default y

config STM_ASC_SERIAL
	bool "ST Serial driver"

config STM_FSM_SPI_FLASH
	bool "ST FSM SPI Flash selected"

config STM_SDHCI
    bool "ST SDHCI Driver"

config STM_SDHCI_0
    bool "ST SDHCI0 Driver"
    depends on STM_SDHCI

config STM_SDHCI_1
    bool "ST SDHCI1 Driver"
    default n
    depends on STM_SDHCI

choice
    prompt "STMicroelectronics board select"

config TARGET_SPACEX_CATSON_HVK_SMODEM
    bool "SpaceX Catson SMODEM HVK"
    select ARM64
    select STM_GLLCFF
    select SPACEX
    select SPACEX_DEFAULT_ENV_INLINE_IN_BINARY

config TARGET_SPACEX_CATSON_HVK_UT
    bool "SpaceX Catson SMODEM HVK"
    select ARM64
    select STM_GLLCFF
    select SPACEX
    select SPACEX_DEFAULT_ENV_INLINE_IN_BINARY

config TARGET_SPACEX_CATSON_UTERM_DEV
    bool "SpaceX Catson User Terminal Development Board"
    select ARM64
    select STM_GLLCFF
    select SPACEX
    select SPACEX_DEFAULT_ENV_INLINE_IN_BINARY

config TARGET_SPACEX_CATSON_UTERM
    bool "SpaceX Catson User Terminal"
    select ARM64
    select STM_GLLCFF
    select SPACEX
    select SPACEX_DEFAULT_ENV_INLINE_IN_BINARY

config TARGET_SPACEX_CATSON_SMODEM
    bool "SpaceX Catson Starlink Modem Block"
    select ARM64
    select STM_GLLCFF
    select SPACEX
    select SPACEX_DEFAULT_ENV_INLINE_IN_BINARY

config TARGET_SPACEX_CATSON_FLASHER
    bool "SpaceX Catson Flasher"
    select ARM64
    select STM_GLLCFF
    select SPACEX
    select SPACEX_DEFAULT_ENV_INLINE_IN_BINARY

endchoice

choice
       prompt "Select Boot Device"

config CATSON_SPI_BOOT
       bool
       select CATSON_NOR_ENABLED
       prompt "Boot Using SPI Nor Flash"

config CATSON_EMMC_BOOT
        bool
        select CATSON_EMMC_ENABLED
        prompt "Boot Using eMMC"

endchoice

config CATSON_NOR_ENABLED
        bool
        default n
        prompt "Enable SPI NOR on Catson"
        help
          Enables the STM SPI NOR controller for Catson

config CATSON_EMMC_ENABLED
        bool
        default n
        prompt "Enable eMMC on Catson"
        help
          Enables the STM eMMC controller for Catson

source "board/spacex/spacex_catson_uterm/Kconfig"

endif
```

## board/spacex/spacex_catson_uterm/Kconfig
```kconfig
if TARGET_SPACEX_CATSON_UTERM

config SYS_BOARD
    default "spacex_catson_uterm"

config SYS_VENDOR
    default "spacex"

config SYS_SOC
    default "gllcff"

config SYS_CONFIG_NAME
    default "SPACEX_CATSON_UTERM"

endif
```

## configs/SPACEX_CATSON_UTERM_EMMC_defconfig
```kconfig
CONFIG_ARM=y
CONFIG_ARCH_GLL=y
CONFIG_TARGET_SPACEX_CATSON_UTERM=y
CONFIG_CATSON_EMMC_BOOT=y
CONFIG_FIT=y
CONFIG_FIT_SIGNATURE=y
CONFIG_FIT_VERBOSE=y
CONFIG_CMD_IMLS=n
CONFIG_USB=n
CONFIG_DISPLAY_CPUINFO=n
CONFIG_OF_LIBFDT=y
CONFIG_CMD_RUN=y
CONFIG_CMD_IMI=y
CONFIG_CMD_XIMG=y
CONFIG_CMD_MEMORY=y
CONFIG_CMD_CACHE=y
CONFIG_HUSH_PARSER=y
CONFIG_SYS_ARM_ARCH=8
CONFIG_SYS_CACHE_SHIFT_6=y
CONFIG_SYS_CACHELINE_SIZE=64
CONFIG_ARM64_SUPPORT_AARCH32=y
CONFIG_ARCH_FIXUP_FDT_MEMORY=y
CONFIG_MD5=y
CONFIG_SPACEX_CMD_SXID=y
CONFIG_SPACEX_POR_GPIO=n
CONFIG_OF_SEPARATE=y
CONFIG_DEFAULT_DEVICE_TREE="spacex_dev_catson"
CONFIG_DM=y
CONFIG_CMD_PING=y
CONFIG_SYS_TEXT_BASE=0xBF000000
CONFIG_ENV_IS_NOWHERE=y
CONFIG_ENV_SIZE=0x2000
CONFIG_NR_DRAM_BANKS=1
CONFIG_CMD_BOOTI=y
CONFIG_CMD_LZMA=y
CONFIG_BOOTDELAY=0
CONFIG_PARTITIONS=n
CONFIG_EFI_LOADER=n
CONFIG_BLK=n
CONFIG_MMC_SDHCI=y
CONFIG_STM_SDHCI=y
CONFIG_STM_SDHCI_0=y
CONFIG_SYS_TEXT_BASE=0xBF000000
CONFIG_ENV_IS_NOWHERE=y
CONFIG_ENV_SIZE=0x2000
CONFIG_NR_DRAM_BANKS=1
CONFIG_CMD_BOOTI=y
CONFIG_CMD_LZMA=y
CONFIG_BOOTDELAY=0
CONFIG_PARTITIONS=n
CONFIG_CATSON_EMMC_ENABLED=y
CONFIG_EFI_LOADER=n
CONFIG_TFTP_TIMEOUT=1110
CONFIG_USE_BOOTARGS=y
CONFIG_AUTOBOOT_STOP_STR="falcon"
```

## drivers/stm/gllcff/Kconfig
```kconfig
config SPACEX_CATSON_MODEMLINK
    bool "Enables modemlink support for Catson"
    depends on STM_GLLCFF
    help
      Enable the modemlink driver and all related drivers needed for
      connectivity
```

## drivers/uboot_fpga_loader/Kconfig
```kconfig
config UBOOT_FPGA_LOADER
	bool "Enable loading fpga from bitstream during u-boot"
```

## net/Kconfig
```kconfig
#
# Network configuration
#

menuconfig NET
	bool "Networking support"
	default y

if NET

config NET_RANDOM_ETHADDR
	bool "Random ethaddr if unset"
	help
	  Selecting this will allow the Ethernet interface to function
	  even when the ethaddr variable for that interface is unset.
	  A new MAC address will be generated on every boot and it will
	  not be added to the environment.

config NETCONSOLE
	bool "NetConsole support"
	help
	  Support the 'nc' input/output device for networked console.
	  See README.NetConsole for details.

config IP_DEFRAG
	bool "Support IP datagram reassembly"
	default n
	help
	  Selecting this will enable IP datagram reassembly according
	  to the algorithm in RFC815.

config NET_MAXDEFRAG
	int "Size of buffer used for IP datagram reassembly"
	depends on IP_DEFRAG
	default 16384
	range 1024 65536
	help
	  This defines the size of the statically allocated buffer
	  used for reassembly, and thus an upper bound for the size of
	  IP datagrams that can be received.

config TFTP_BLOCKSIZE
	int "TFTP block size"
	default 1468
	help
	  Default TFTP block size.

if SPACEX
config NET_DO_NOT_TRY_ANOTHER
	bool "Prevent network interface cycling"
	default y
	help
	  Prevent network inferface cycling. This prevents the primary
	  network inferface's DMA from being left enabled after U-Boot
	  completes, as described in ticket PLAT-935.
endif

config TFTP_TIMEOUT
	int "TFTP timeout length in ms"
	default 5000
	help
	  Timeout in ms to wait for a TFTP response before initiating a retry
	  or failure.

endif   # if NET
```

## spacex/Kconfig
```kconfig
menuconfig SPACEX
	bool "SpaceX board support"
	select CMD_RDATE
	select SPACEX_ECC
	select CMD_UNECC
	help
	  Enables code common to all SpaceX boards.

	  This option should be enabled automatically by the board's Kconfig
	  entry.

if SPACEX

config SPACEX_DEFAULT_ENV_INLINE_IN_BINARY
	bool "U-Boot binary is unencoded in flash"
	help
	  The U-Boot image is stored on the flash as a flat binary (e.g. not
	  ECC- or PBL- encoded), then we can pull the default environment in
	  fw_resetenv directly from the U-Boot binary.

	  This option should be enabled automatically, if applicable, by the
	  board's Kconfig entry.

config SPACEX_ECC
	bool "Support for ECC"
	help
	  This option enables support for ECC armoring of the
	  environment, device tree blob, and kernel image.

config SPACEX_POR_GPIO
    bool "Support for SpaceX POR GPIO configuration"
    default y
    help
      This option enables the SpaceX Power on Reset GPIO sequence.  This is an
      optionally defined device tree list of GPIOs in the por-gpio device tree.
      Subnodes take the form of assert-low, assert-high, or wait-high and link
      to a GPIO which will be set appropriately.  This option depends on the
      platform containing a GPIO controller.

config SPACEX_TELEM
	bool "Enable BWP telemetry console"
	default n
	help
	  This option enables a lightweight BWP console emitter.  When set,
	  CONFIG_TELEM_DEST_IP must be defined and must be a multicast address.

config TELEM_DEST_IP
	string "BWP Telemetry IP Destination"
	depends on SPACEX_TELEM
	default 239.26.7.129
	help
	  This is the destination to send SpaceX BWP style console telemetry to.
	  This address may be multicast.

config SPACEX_ARP_RETRY
	bool "Configurable number of ARP retries"
	default n
	help
	  Allow for a custom number of arp retries.

config SPACEX_ARP_RETRY_COUNT
	int "Number of ARP retries"
	depends on SPACEX_ARP_RETRY
	default 5

endif
```
